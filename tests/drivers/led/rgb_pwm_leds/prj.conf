## CMakeLists.txt
```
# SPDX-License-Identifier: Apache-2.0

cmake_minimum_required(VERSION 3.20.0)

find_package(Zephyr REQUIRED HINTS $ENV{ZEPHYR_BASE})
project(rgb_pwm_leds_tests)

FILE(GLOB app_sources src/*.c)
target_sources(app PRIVATE ${app_sources})
```

## prj.conf
```kconfig
CONFIG_LED=y
CONFIG_ZTEST=y
CONFIG_ZTEST_NEW_API=y
CONFIG_LOG=y
CONFIG_LED_PWM=y
CONFIG_RGB_PWM_LEDS=y
CONFIG_PWM=y
```

## boards/mimxrt685_evk_cm33.overlay
```dts
/ {
	rgb {
		status = "okay";
		compatible = "rgb-pwm-leds";
		pwm-leds = <&pwmleds>;
		init-rgba = [FF FF FF 20];
	};
};
```

## src/main.c
```c
/*
 * Copyright (c) Meta Platforms, Inc. and affiliates.
 *
 * SPDX-License-Identifier: Apache-2.0
 */


#include "zephyr/drivers/led.h"
#include "zephyr/kernel.h"
#include <zephyr/ztest.h>
#include <stdint.h>

static const uint8_t RED[] = {0xFF, 0, 0, 0x7F};
static const uint8_t GREEN[] = {0, 0xFF, 0, 0x7F};
static const uint8_t BLUE[] = {0, 0, 0xFF, 0x7F};
const uint8_t *COLORS[] = {RED, GREEN, BLUE};
#define NUM_COLORS  ARRAY_SIZE(COLORS)
#define NUM_RGBA_CHANNELS  4
#define IGNORE_LED_INDEX   0

ZTEST_SUITE(rgb_pwm_led_tests, NULL, NULL, NULL, NULL, NULL);

/**
 * @brief Test all colors
 *
 * This test goes through red, green and blue leds and turns them on/off
 *
 */
ZTEST(rgb_pwm_led_tests, test_all_colors)
{
	const struct device *leds = DEVICE_DT_GET_ONE(rgb_pwm_leds);
	int ret;

	for (int color = 0; color < NUM_COLORS; color++) {
		ret = led_set_color(leds, IGNORE_LED_INDEX, NUM_RGBA_CHANNELS, COLORS[color]);
		zassert_ok(ret);
		k_sleep(K_MSEC(500));
		ret = led_off(leds, color);
		zassert_ok(ret);
	}
}
```
