## boards/arm/cy8ckit_062_pioneer/Kconfig.board
```kconfig
# PSoC6 BLE Pioneer Kit configuration

# Copyright (c) 2018 Cypress
# Copyright (c) 2020 ATL Electronics
# SPDX-License-Identifier: Apache-2.0

config BOARD_CY8CKIT_062_PIONEER_M4
	bool "PSoC6 BLE Pioneer Kit"
	depends on SOC_CY8C6244LQI_S4D92
```

## boards/arm/cy8ckit_062_pioneer/Kconfig.defconfig
```kconfig
# PSoC6 BLE Pioneer Kit configuration

# Copyright (c) 2018 Cypress
# Copyright (c) 2020 ATL Electronics
# SPDX-License-Identifier: Apache-2.0

if BOARD_CY8CKIT_062_PIONEER_M4

config BOARD
	default "cy8ckit_062_pioneer_m4" if BOARD_CY8CKIT_062_PIONEER_M4  

endif #BOARD_CY8CKIT_062_PIONEER_M4
```

## drivers/led/Kconfig.rgb_pwm_leds
```kconfig
# (c) Meta Platforms, Inc. and affiliates.
# SPDX-License-Identifier: Apache-2.0

config RGB_PWM_LEDS
	bool "RGB PWM LED driver"
	default y
	depends on LED_PWM && DT_HAS_RGB_PWM_LEDS_ENABLED
	help
	  Enable driver for RGB PWM LEDs.
```

## drivers/lora/Kconfig.rylrxxx
```kconfig
config LORA_RYLRXXX
	bool "Reyax LYLR driver"
	default n
	depends on DT_HAS_REYAX_RYLRXXX_ENABLED
	help
	  Enable the Reyax LYLR driver 

config LORA_RYLRXX_RX_QUEUE_DEPTH
    int "rylr msg queue depth"
    default 4
    help 
        configure the depth of rylr rx queue

config LORA_RYLRXX_RX_QUEUE_WIDTH
    int "rylr rx queue width"
    default 256
    help
        Configure the message size in rylr rx queu
```

## dts/bindings/led/rgb-pwm-leds.yaml
```yaml
# (c) Meta Platforms, Inc. and affiliates.
# SPDX-License-Identifier: Apache-2.0

description: Adds support for color mixing to a  pwm-leds node with a red, green and blue leds

compatible: "rgb-pwm-leds"

properties:
  pwm-leds:
    required: true
    type: phandle
  init-rgba:
    type: uint8-array
    default: [0x7F, 0x7F, 0x7F, 0x7F]
```

## dts/bindings/lora/reyax,rylrxxx.yaml
```yaml
# Copyright (c) 2023 David Ullmann
# SPDX-License-Identifier: Apache-2.0

description: Reyax lora module with AT-command serial interface

compatible: "reyax,rylrxxx"

include: uart-device.yaml
```

## dts/bindings/pwm/nxp,ctimer-pwm.yaml
```yaml
# (c) Meta Platforms, Inc. and affiliates.
# SPDX-License-Identifier: Apache-2.0

description: NXP CTimer PWM

compatible: "nxp,ctimer-pwm"

include: [pwm-controller.yaml, pinctrl-device.yaml, base.yaml, "nxp,lpc-ctimer.yaml"]

properties:
  reg:
    required: true

  prescaler:
    type: int
    default: 1
    description: prescaling value

  period-channel:
    type: int
    required: true
    description: counter for period of pwm signal. must be different than pulse channel

  clk-source:
    type: int
    required: true
    description: clock to use

  "#pwm-cells":
    const: 3

pwm-cells:
  - channel
  - period
  - flags
```

## soc/arm/infineon_cat1/psoc6/Kconfig.defconfig.soc.psoc6_04
```kconfig
# SPDX-License-Identifier: Apache-2.0


if SOC_DIE_PSOC6_04

config NUM_IRQS
	default 16 if CPU_CORTEX_M0PLUS
	default 175 if CPU_CORTEX_M4

config SOC
	default "CY8C6244LQI_S4D92" if SOC_CY8C6244LQI_S4D92


endif # SOC_DIE_PSOC6_04
```

## tests/drivers/led/rgb_pwm_leds/testcase.yaml
```yaml
tests:
  drivers.rgb_pwm_leds:
    build_only: false
    tags:
      - drivers
      - led
      - pwm
```
